/*******************************************************************************
        => I2C（总线）
*******************************************************************************/
SDA             BIT     P2^0
SCL             BIT     P2^1
DATA            EQU     30H
DEV_ADDR        EQU             ;//IIC__器件地址
MEM_ADDR        EQU     31H     ;//IIC__器件内部存储地址



/*******************************************************************************
        => I2C（主程序）
*******************************************************************************/
        ORG     0000H
        LJMP    START
        ORG     0030H
START:
        MOV     DPTR, #TABLE
        SETB    SCL             ;//初始化（I2C）
        SETB    SDA
        MOV     DATA, #0
        MOV     ADDRESS, #1
        MOV     A, ADDRESS
        CALL    READ_ADDRESS
        CALL    COMPARE
MAIN:
        INC     A
        MOV     DATA, A
        CALL    DISPLAY
        MOV     A, ADDRESS
        CALL    WRITE_ADDRESS
COMPARE:
        PUSH    ACC
        MOV     B, #9
        CLR     C
        SUBB    A, B
        JNB     ACC.7, COMPARE_00
        POP     ACC
COMPARE_00:
        MOV     A, #0
        JMP     MAIN
        RET
        
;//____________________________________________________________
;//显示函数
;//____________________________________________________________
SMG_DISPLAY:
        MOVC    A, @A+DPTR
        MOV     P0, A
        RET



/*******************************************************************************
        => I2C（主程序）
*******************************************************************************/
;//____________________________________________________________
;// IIC 起始信号
;//____________________________________________________________
IIC_START:
        SETB    SDA
        SETB    SCL
        NOP
        NOP
        CLR     SDA
        NOP
        NOP
        NOP
        NOP
        CLR     SCL
        RET
;//____________________________________________________________
;// IIC 终止信号
;//____________________________________________________________
IIC_STOP:
        CLR     SDA
        NOP
        NOP
        SETB    SCL
        NOP
        NOP
        NOP
        NOP
        SETB    SDA
        NOP
        NOP
        CLR     SDA
        CLR     SCL
        RET
;//____________________________________________________________
;// IIC 应答信号
;//____________________________________________________________
IIC_ACK:
        CLR     SCL
        SETB    SDA
        NOP
        NOP
        SETB    SCL
        NOP
        NOP
        NOP
        NOP
        MOV     C, SDA
        JC      IIC_ACK         ;//C中为1，则转移（等待应答）
        CLR     SCL
        CLR     SDA
        RET
;//____________________________________________________________
;// IIC 发送一个字节
;//____________________________________________________________
SEND_BYTE:
        MOV     R7, #08
SEND_BIT:                       ;//在调用之前，先把写入的命令（写入A中）
        RLC     A
        MOV     SDA, C
        SETB    SCL
        NOP
        NOP
        NOP
        NOP
        CLR     SCL
        DJNZ    R7, SEND_BIT
;//____________________________________________________________
;// IIC 接收一个字节
;//____________________________________________________________
RECEIVE_BYTE:
        MOV     R7, #08
        CLR     A
        SETB    SDA
RECEIVE_BIT:
        CLR     SCL
        NOP
        NOP
        NOP
        NOP
        SETB    SCL
        NOP
        NOP
        NOP
        NOP
        MOV     C, SDA
        RLC     A
        SETB    SDA
        DJNZ    R7, RECEIVE_BIT
        RET
;//____________________________________________________________
;// 主机向AT24C02的内存中写入一个字节的数据
;//____________________________________________________________ 
//、、在这之前，首先要把写入的地址写入（MEM_ADDR）中， 再传入（累加器A中）
//、、在这之前，首先要把写入的数据写入（DATA）中， 再传入（累加器A中）
WRITE_ADDRESS:
        CALL    IIC_START       ;//主机发送起始信号
        MOV     A, #0A0H        ;//写入器件地址（呼叫器件）
        CALL    SEND_BYTE       ;//发送器地址
        CALL    IIC_ACK         ;//读取从机应答信号
        MOV     A, ADDRESS      ;//写入器件内部地址
        CALL    SEND_BYTE       ;//发送器内部存储器地址
        CALL    IIC_ACK         ;//读取从机应答信号
        MOV     A, DATA         ;//向指定内存写入数据
        CALL    SEND_BYTE       ;//发送一个字节数据
        CALL    IIC_ACK         ;//读取从机应答信号
        CALL    IIC_STOP        ;//主机发送停止信号
        RET
        
;//____________________________________________________________
;//  主机从AT24C02的内存中读取一个字节的数据
;//____________________________________________________________   
READ_ADDRESS:
        CALL    IIC_START       ;//主机发送起始信号
        MOV     A, #0A0H        ;//写入器件地址（呼叫器件）
        CALL    SEND_BYTE       ;//发送器地址
        CALL    IIC_ACK         ;//读取从机应答信号
        MOV     A, ADDRESS      ;//写入器件内部地址
        CALL    SEND_BYTE       ;//发送器内部存储器地址
        CALL    IIC_ACK         ;//读取从机应答信号
        
        CALL    IIC_START       ;//主机发送起始信号
        MOV     A, #0A1H        ;//（呼叫器件），告诉它要读取数据了
        CALL    SEND_BYTE       ;//
        CALL    IIC_ACK         ;//
        
        CALL    RECEIVE_BTYE    ;//
        CALL    IIC_STOP
        RET



/*******************************************************************************
        => I2C（主程序）
*******************************************************************************/
;//____________________________________________________________
;//共阳极数码管编码表（0~F）
;//____________________________________________________________
TABLE:
        DB   0xC0, 0xF9, 0xA4, 0xB0, 0x99, 0x92, 0x82, 0xF8
        DB   0x80, 0x90, 0x88, 0x83, 0xC6, 0xA1, 0x86, 0x8e
        END
