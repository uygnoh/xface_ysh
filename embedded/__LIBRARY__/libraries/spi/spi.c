#include "spi.h"


/*******************************************************************************
  函数名称: spi_write()
  输入参数: (uint8_t dat)，要写入的数据
  输出参数: 无
  函数功能: 写入一个字节数据(高位在前， 低位在后) //从最高位开始, 先把数据准备好
          从机在上升沿采样， 在上升沿之前“主机”要把数据准备好
          
*******************************************************************************/
void spi_write(uint8_t dat)
{
        uint8_t i;
        for (i = 0; i < 8; i++) {
                SCLK = 0;                       //时钟线拉低, 先把数据准备好
                if ((dat & 0x80) == 0x80) {     //判断当前传输位是“1”还是“0”                                
                        MOSI = 1;               //主机发送，从机接收              
                } else {
                        MOSI = 0;
                }
                dat <<= 1;                      //准备下一个数据位
                SCLK = 1;                       //上升沿，数据采样
        }
}

/*******************************************************************************
  函数名称: spi_read()
  输入参数: 无
  输出参数: 返回从SPI总线上读取到一个字节的数据(高位在前， 低位在后)
  函数功能: 读入一个字节数据， 主机在上升沿采样， 在上升沿之前“从机”要把数据准备好
*******************************************************************************/
uint8_t spi_read(void)
{
        uint8_t i;
        uint8_t dat;
        for (i = 0; i < 8; i++) {
                SCLK  = 0;              //时钟下降沿期间，从机准备好数据
                SCLK  = 1;              //来一个上升沿，主机采样总线上的数据
                dat <<= 1;              //dat右移1位
                if (MISO == 1) {        //主机接收，从机发送
                        dat |= 0x01;
                } else {
                        dat &= 0xFE;
                }
        }
        return(dat);
}


uint8_t spi_transmit(uint8_t dat)
{
        uint8_t i;
        SPI_SCK  = 0;
        for (i = 0; i < 8; i++) {
                SPI_MOSI = data & 0x80;
                dat    <<= 1;
                SPI_SCK  = 1;           //上升沿， 从机采样数据
                dat     |= SPI_MISO;
                SPI_SCK  = 0;           //下降沿， 主机采样数据
        }
        return(dat);
}
